VERSION "cannet-common-scale 1.0"

NS_ :

BS_:

BU_: FIXTURE

BO_ 256 MixedPair: 8 FIXTURE
 SG_ SmallVolts : 0|16@1+ (0.0001,-1.5) [-1.5|0] "V" FIXTURE
 SG_ BigAmps : 16|16@1+ (0.01,-200) [-200|0] "A" FIXTURE

BO_ 257 BarePair: 8 FIXTURE
 SG_ SmallBare : 0|16@1+ (0.0001,-1.5) [-1.5|0] "" FIXTURE
 SG_ BigBare : 16|16@1+ (0.01,-200) [-200|0] "" FIXTURE

CM_ BO_ 256 "The owner's 0.9.0 observation, as data: a volts signal spanning -1.5..0 listed before an amps signal spanning -200..0. Pre-fix, unified mode drew BigAmps against SmallVolts's axis labels.";
CM_ BO_ 257 "The same amplitudes with no units at all — the shape that also broke per-unit mode, and the likelier one in the wild (a DBC that declares no unit).";
