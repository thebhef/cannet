VERSION "cannet-extrapolation 1.0"

NS_ :

BS_:

BU_: FIXTURE

BO_ 256 RefRamp: 8 FIXTURE
 SG_ RefLevel : 0|16@1+ (0.01,0) [0|655.35] "%" FIXTURE

BO_ 257 StoppedRamp: 8 FIXTURE
 SG_ StoppedLevel : 0|16@1+ (0.01,0) [0|655.35] "%" FIXTURE

BO_ 258 StalledRamp: 8 FIXTURE
 SG_ StalledLevel : 0|16@1+ (0.01,0) [0|655.35] "%" FIXTURE

BO_ 259 OneShot: 8 FIXTURE
 SG_ OneShotLevel : 0|16@1+ (0.01,0) [0|655.35] "%" FIXTURE

BO_ 512 DenseState: 8 FIXTURE
 SG_ DenseMode : 0|8@1+ (1,0) [0|255] "" FIXTURE

BO_ 513 StoppedState: 8 FIXTURE
 SG_ StoppedMode : 0|8@1+ (1,0) [0|255] "" FIXTURE

BO_ 514 StalledState: 8 FIXTURE
 SG_ StalledMode : 0|8@1+ (1,0) [0|255] "" FIXTURE

CM_ BO_ 256 "Arrives for the whole capture — the reference series that puts the window's right edge past every other series' last sample.";
CM_ BO_ 257 "Stops 8 s in: the stretch to the window's right edge is a hold, not a reading.";
CM_ BO_ 258 "Stalls between 6 s and 13 s — an interior gap far longer than its own 100 ms cadence.";
CM_ BO_ 259 "Exactly one frame, at 10 s: drawn as a horizontal line whose every stretch is extrapolation.";
CM_ BO_ 512 "Arrives for the whole capture — solid tiles, and the lane whose sample markers show the cadence.";
CM_ BO_ 513 "Stops 6 s in, with its last transition at 3 s: one tile, partly read and partly held.";
CM_ BO_ 514 "Stalls between 7 s and 15 s inside a single held state: a tile stale in its middle.";

VAL_ 512 DenseMode 0 "Idle" 1 "Arming" 2 "Active" 3 "Derate" 4 "Fault" ;
VAL_ 513 StoppedMode 0 "Standby" 1 "Running" ;
VAL_ 514 StalledMode 0 "Closed" 1 "Opening" 2 "Open" ;
