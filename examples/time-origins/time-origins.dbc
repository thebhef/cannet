VERSION ""

NS_ :

BS_:

BU_: ECU

BO_ 256 EngineData: 8 ECU
 SG_ Rpm : 0|16@1+ (1,0) [0|65535] "rpm" Vector__XXX
 SG_ CoolantTemp : 16|8@1- (1,-40) [-40|87] "degC" Vector__XXX

BO_ 512 Status: 8 ECU
 SG_ Mode : 0|3@1+ (1,0) [0|7] "" Vector__XXX
 SG_ Counter : 8|8@1+ (1,0) [0|255] "" Vector__XXX

VAL_ 512 Mode 0 "Idle" 1 "Drive" 2 "Charge" ;
